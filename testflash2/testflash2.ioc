# file: testflash2.ioc
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Mcu.Family=STM32F1
RCC.PLLSourceVirtual=RCC_PLLSOURCE_HSE
RCC.PLLMUL=RCC_PLL_MUL9
RCC.APB2Freq_Value=72000000
PD1-OSC_OUT.Mode=HSE-External-Oscillator
PA14.Mode=Serial_Wire
VP_SYS_VS_tim1.Mode=TIM1
PA13.Mode=Serial_Wire
Mcu.Name=STM32F103C(8-B)Tx
NVIC.TIM1_UP_IRQn=true\:0\:0\:false\:false\:true\:false\:true
PD0-OSC_IN.Signal=RCC_OSC_IN
RCC.APB1CLKDivider=RCC_HCLK_DIV2
RCC.SYSCLKFreq_VALUE=72000000
Mcu.Package=LQFP48
RCC.SYSCLKSource=RCC_SYSCLKSOURCE_PLLCLK
ProjectManager.StackSize=0x400
NVIC.TimeBase=TIM1_UP_IRQn
PD1-OSC_OUT.Signal=RCC_OSC_OUT
PA13.Signal=SYS_JTMS-SWDIO
NVIC.TimeBaseIP=TIM1
PA14.Signal=SYS_JTCK-SWCLK
ProjectManager.HeapSize=0x200
ProjectManager.TargetToolchain=STM32CubeIDE
NVIC.PriorityGroup=NVIC_PRIORITYGROUP_4
RCC.HCLKFreq_Value=72000000
RCC.APB2TimFreq_Value=72000000
RCC.APB1TimFreq_Value=72000000
RCC.USBFreq_Value=72000000
RCC.APB1Freq_Value=36000000
RCC.AHBFreq_Value=72000000
PD0-OSC_IN.Mode=HSE-External-Oscillator
board=custom

// file: Core/Src/main.c
/* USER CODE BEGIN Header */
/**
  ******************************************************************************
  * @file           : main.c
  * @brief          : Main program body
  ******************************************************************************
  * @attention
  *
  * <h2><center>&copy; Copyright (c) 2024 STMicroelectronics.
  * All rights reserved.</center></h2>
  *
  * This software component is licensed by ST under BSD 3-Clause license,
  * the "License"; You may not use this file except in compliance with the
  * License. You may obtain a copy of the License at:
  *                        opensource.org/licenses/BSD-3-Clause
  *
  ******************************************************************************
  */
/* USER CODE END Header */
#include "main.h"

/* USER CODE BEGIN Includes */
#include "FlASH_PAGE_F1.h"
#include "FreeRTOS.h"
#include "task.h"
#include "queue.h"
/* USER CODE END Includes */

/* USER CODE BEGIN PD */
#define	PAGE_ADDR_1	0x0801FC00
#define FLASH_BUFFER_SIZE 64
/* USER CODE END PD */

/* USER CODE BEGIN PV */
typedef struct {
	uint32_t accion;
	uint32_t nroUsuario;
	uint32_t clave;
	uint32_t nroIntentos;
}usuario;

typedef enum{
	READ,
	WRITE
}accion_e;

QueueHandle_t cmd = NULL, data = NULL;

uint32_t buffer[FLASH_BUFFER_SIZE];
uint32_t datos[4];

/* USER CODE END PV */

void SystemClock_Config(void);
static void MX_GPIO_Init(void);

static void dummyDataMemoryRecording(void);

/* USER CODE BEGIN 0 */
static void dummyDataMemoryRecording (void){
	uint32_t bufferAux[FLASH_BUFFER_SIZE];
	for(int i = 0; i < FLASH_BUFFER_SIZE; i++){
	  bufferAux[i] = i;
	}
	Flash_Write_Data(PAGE_ADDR_1, bufferAux, FLASH_BUFFER_SIZE);
}

static void t_flashtask(void *pvParameters){

	uint32_t aux_ADDR=PAGE_ADDR_1;
	uint32_t index = 0;
	usuario value;
	//flashdata response;

	uint32_t buffer2[FLASH_BUFFER_SIZE];

	while(1){
		xQueueReceive(cmd, &value, portMAX_DELAY);

		switch(value.accion){

		case READ:		//lectura de un valor en particular
			//aux_ADDR = PAGE_ADDR_1 + value.nroUsuario * 2;
			index = (2 * (value.nroUsuario)) + 1;
			Flash_Read_Data(aux_ADDR, buffer2, FLASH_BUFFER_SIZE); //cambiar a 5 el numero de palabras en caso que se desee cambiar por datos en char

			//response.id = (uint8_t)buffer[0];

			value.clave = buffer2[index];

			xQueueSend(data,&value,portMAX_DELAY);

			break;
		case WRITE:		//escritura de un codigo nuevo en la memoria
			Flash_Read_Data(PAGE_ADDR_1, buffer, FLASH_BUFFER_SIZE);
			buffer[value.nroUsuario*2]=value.nroUsuario;
			buffer[value.nroUsuario*2+1]=value.clave;
			Flash_Write_Data(PAGE_ADDR_1, buffer, FLASH_BUFFER_SIZE);
			break;
		default:
			break;

		}
	}
}

static void auxtask(void *pvParameters){
	usuario a;
	a.nroUsuario=0;
	uint8_t i = 0;
	a.clave=9999;
	a.nroIntentos=0;
	while(1){
		/*a.accion=2;
		xQueueSendToBack(flash_cmd_queue, &a, portMAX_DELAY);
		//vTaskDelay(5);*/

		for(i=0 ; i<4 ; i++){
			a.accion = READ;
			xQueueSend(cmd, &a, portMAX_DELAY);
			//vTaskDelay(5/portTICK_PERIOD_MS);
			xQueueReceive(data, &a, portMAX_DELAY);
			if(a.nroUsuario < 4) a.nroUsuario++;
			else a.nroUsuario = 0;

			vTaskDelay(5/portTICK_PERIOD_MS);
		}
	}
}

/* USER CODE END 0 */

int main(void)
{

  /* MCU Configuration--------------------------------------------------------*/

  /* Reset of all peripherals, Initializes the Flash interface and the Systick. */
  HAL_Init();

  /* Configure the system clock */
  SystemClock_Config();

  /* Initialize all configured peripherals */
  MX_GPIO_Init();
  /* USER CODE BEGIN 2 */

  dummyDataMemoryRecording();	//Funcion para grabar datos de prueba en memoria. Graba 0 1 2 3 4...

  cmd = xQueueCreate(1,sizeof(usuario));
  data = xQueueCreate(1,sizeof(usuario));

  xTaskCreate(t_flashtask, "", 256, NULL, tskIDLE_PRIORITY + 2, NULL);
  xTaskCreate(auxtask, "", 256, NULL, tskIDLE_PRIORITY + 1, NULL);

    vTaskStartScheduler();

  /* USER CODE END 2 */

  /* Infinite loop */

}

void SystemClock_Config(void)
{
  RCC_OscInitTypeDef RCC_OscInitStruct = {0};
  RCC_ClkInitTypeDef RCC_ClkInitStruct = {0};

  /** Initializes the RCC Oscillators according to the specified parameters
  * in the RCC_OscInitTypeDef structure.
  */
  RCC_OscInitStruct.OscillatorType = RCC_OSCILLATORTYPE_HSE;
  RCC_OscInitStruct.HSEState = RCC_HSE_ON;
  RCC_OscInitStruct.HSEPredivValue = RCC_HSE_PREDIV_DIV1;
  RCC_OscInitStruct.HSIState = RCC_HSI_ON;
  RCC_OscInitStruct.PLL.PLLState = RCC_PLL_ON;
  RCC_OscInitStruct.PLL.PLLSource = RCC_PLLSOURCE_HSE;
  RCC_OscInitStruct.PLL.PLLMUL = RCC_PLL_MUL9;
  if (HAL_RCC_OscConfig(&RCC_OscInitStruct) != HAL_OK)
  {
    Error_Handler();
  }
  /** Initializes the CPU, AHB and APB buses clocks
  */
  RCC_ClkInitStruct.ClockType = RCC_CLOCKTYPE_HCLK|RCC_CLOCKTYPE_SYSCLK
                              |RCC_CLOCKTYPE_PCLK1|RCC_CLOCKTYPE_PCLK2;
  RCC_ClkInitStruct.SYSCLKSource = RCC_SYSCLKSOURCE_PLLCLK;
  RCC_ClkInitStruct.AHBCLKDivider = RCC_SYSCLK_DIV1;
  RCC_ClkInitStruct.APB1CLKDivider = RCC_HCLK_DIV2;
  RCC_ClkInitStruct.APB2CLKDivider = RCC_HCLK_DIV1;

  if (HAL_RCC_ClockConfig(&RCC_ClkInitStruct, FLASH_LATENCY_2) != HAL_OK)
  {
    Error_Handler();
  }
}

static void MX_GPIO_Init(void)
{

  /* GPIO Ports Clock Enable */
  __HAL_RCC_GPIOD_CLK_ENABLE();
  __HAL_RCC_GPIOA_CLK_ENABLE();

}

 /**
  * @brief  Period elapsed callback in non blocking mode
  * @note   This function is called  when TIM1 interrupt took place, inside
  * HAL_TIM_IRQHandler(). It makes a direct call to HAL_IncTick() to increment
  * a global variable "uwTick" used as application time base.
  * @param  htim : TIM handle
  * @retval None
  */
void HAL_TIM_PeriodElapsedCallback(TIM_HandleTypeDef *htim)
{
  if (htim->Instance == TIM1) {
    HAL_IncTick();
  }
}

void Error_Handler(void)
{
  __disable_irq();
  while (1)
  {
  }
}

/************************ (C) COPYRIGHT STMicroelectronics *****END OF FILE****/
